## src/modules/wifi_provision/Kconfig.wifi_provision
```kconfig
#
# Copyright (c) 2025 Nordic Semiconductor ASA
#
# SPDX-License-Identifier: LicenseRef-Nordic-5-Clause
#

config SOFTAP_WIFI_PROVISION_MODULE
	bool "WiFi provisioning module"
	default n
	select SOFTAP_WIFI_PROVISION
	select NET_CONNECTION_MANAGER
	help
	  Enable softAP WiFi provisioning functionality for the MQTT sample.
	  This allows the device to create a WiFi access point for provisioning
	  network credentials.

if SOFTAP_WIFI_PROVISION_MODULE

config SOFTAP_WIFI_PROVISION_MODULE_PSM_DISABLED_SECONDS
	int "PSM disabled time after provisioning (seconds)"
	default 120
	help
	  Time in seconds to keep PSM disabled after successful provisioning
	  to ensure mDNS service discovery works properly.

module = SOFTAP_WIFI_PROVISION_MODULE
module-str = WiFi Provision
source "subsys/logging/Kconfig.template.log_config"

endif # SOFTAP_WIFI_PROVISION_MODULE 
```
